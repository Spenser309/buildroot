## configs/beagleblack_defconfig
```kconfig
BR2_arm=y
BR2_cortex_a8=y
BR2_TOOLCHAIN_EXTERNAL=y
BR2_TOOLCHAIN_EXTERNAL_CODESOURCERY_ARM201305=y
BR2_TARGET_GENERIC_HOSTNAME="beaglebone"
BR2_ROOTFS_DEVICE_CREATION_DYNAMIC_DEVTMPFS=y
BR2_TARGET_GENERIC_GETTY_PORT="ttyO0"
# BR2_TARGET_GENERIC_REMOUNT_ROOTFS_RW is not set
BR2_PACKAGE_BUSYBOX_CONFIG="board/beagleblack/busybox_config"
BR2_PACKAGE_AM33X_CM3=y
BR2_PACKAGE_BEAGLE_CAPES=y
BR2_PACKAGE_TI_GFX=y
BR2_PACKAGE_TI_GFX_DEBUG=y
BR2_PACKAGE_TI_GFX_EGLIMAGE=y
BR2_PACKAGE_TI_GFX_ES8=y
BR2_PACKAGE_HOST_E2FSPROGS=y
BR2_PACKAGE_HOST_GENEXT2FS=y
BR2_TARGET_ROOTFS_CPIO=y
BR2_TARGET_ROOTFS_CPIO_GZIP=y
BR2_TARGET_UBOOT=y
BR2_TARGET_UBOOT_BOARDNAME="am335x_evm"
BR2_TARGET_UBOOT_CUSTOM_VERSION=y
BR2_TARGET_UBOOT_CUSTOM_VERSION_VALUE="2013.04"
BR2_TARGET_UBOOT_FORMAT_IMG=y
BR2_TARGET_UBOOT_SPL=y
BR2_TARGET_UBOOT_SPL_NAME="MLO"
BR2_LINUX_KERNEL=y
BR2_LINUX_KERNEL_CUSTOM_VERSION=y
BR2_LINUX_KERNEL_CUSTOM_VERSION_VALUE="3.8.13"
BR2_LINUX_KERNEL_PATCH="http://rcn-ee.net/deb/sid-armhf/v3.8.13-bone23/patch-3.8.13-bone23.diff.gz board/beagleblack/linux-patches"
BR2_LINUX_KERNEL_USE_CUSTOM_CONFIG=y
BR2_LINUX_KERNEL_CUSTOM_CONFIG_FILE="board/beagleblack/linux_defconfig"
BR2_LINUX_KERNEL_DTS_SUPPORT=y
BR2_LINUX_KERNEL_INTREE_DTS_NAME="am335x-boneblack"
BR2_LINUX_KERNEL_INSTALL_TARGET=y
```

## configs/beaglexm_defconfig
```kconfig
BR2_arm=y
BR2_cortex_a8=y
BR2_TARGET_GENERIC_HOSTNAME="beaglexm"
BR2_ROOTFS_DEVICE_CREATION_DYNAMIC_MDEV=y
BR2_TARGET_GENERIC_GETTY_PORT="ttyO2"
# BR2_TARGET_GENERIC_REMOUNT_ROOTFS_RW is not set
BR2_TARGET_ROOTFS_EXT2=y
BR2_TARGET_ROOTFS_TAR_GZIP=y
BR2_TARGET_UBOOT=y
BR2_TARGET_UBOOT_BOARDNAME="omap3_beagle"
BR2_TARGET_UBOOT_CUSTOM_VERSION=y
BR2_TARGET_UBOOT_CUSTOM_VERSION_VALUE="2013.04"
BR2_TARGET_UBOOT_FORMAT_IMG=y
BR2_TARGET_UBOOT_SPL=y
BR2_TARGET_UBOOT_SPL_NAME="MLO"
BR2_LINUX_KERNEL=y
BR2_LINUX_KERNEL_DEFCONFIG="omap2plus"
BR2_LINUX_KERNEL_UIMAGE_LOADADDR="0x80008000"
BR2_LINUX_KERNEL_INSTALL_TARGET=y
```

## configs/beaglexm_demo_defconfig
```kconfig
BR2_arm=y
BR2_cortex_a8=y
BR2_CCACHE=y
BR2_TOOLCHAIN_EXTERNAL=y
BR2_TOOLCHAIN_EXTERNAL_CODESOURCERY_ARM201305=y
BR2_TOOLCHAIN_EXTERNAL_GDB_SERVER_COPY=y
BR2_TARGET_GENERIC_HOSTNAME="beaglexm"
BR2_ROOTFS_DEVICE_CREATION_DYNAMIC_MDEV=y
BR2_TARGET_GENERIC_GETTY_PORT="ttyO2"
# BR2_TARGET_GENERIC_REMOUNT_ROOTFS_RW is not set
BR2_PACKAGE_BUSYBOX_CONFIG="board/beaglexm/busybox_config"
BR2_PACKAGE_GSTREAMER1=y
BR2_PACKAGE_GST1_PLUGINS_BASE_PLUGIN_VIDEOTESTSRC=y
BR2_PACKAGE_GST1_PLUGINS_GOOD=y
BR2_PACKAGE_GST1_PLUGINS_GOOD_JPEG=y
BR2_PACKAGE_GST1_PLUGINS_GOOD_PNG=y
BR2_PACKAGE_GST1_PLUGINS_BAD=y
BR2_PACKAGE_GST1_PLUGINS_BAD_PLUGIN_VIDEOPARSERS=y
BR2_PACKAGE_GST1_PLUGINS_BAD_PLUGIN_EGLGLES=y
BR2_PACKAGE_TI_GFX=y
BR2_PACKAGE_TI_GFX_DEBUG=y
BR2_PACKAGE_TI_GFX_DEMOS=y
BR2_PACKAGE_TI_GFX_ES5=y
BR2_TARGET_ROOTFS_EXT2=y
BR2_TARGET_ROOTFS_TAR_GZIP=y
BR2_TARGET_UBOOT=y
BR2_TARGET_UBOOT_BOARDNAME="omap3_beagle"
BR2_TARGET_UBOOT_CUSTOM_VERSION=y
BR2_TARGET_UBOOT_CUSTOM_VERSION_VALUE="2013.04"
BR2_TARGET_UBOOT_FORMAT_IMG=y
BR2_TARGET_UBOOT_SPL=y
BR2_TARGET_UBOOT_SPL_NAME="MLO"
BR2_LINUX_KERNEL=y
BR2_LINUX_KERNEL_PATCH="board/beaglexm/linux-patches/"
BR2_LINUX_KERNEL_USE_CUSTOM_CONFIG=y
BR2_LINUX_KERNEL_CUSTOM_CONFIG_FILE="board/beaglexm/linux_defconfig"
BR2_LINUX_KERNEL_UIMAGE_LOADADDR="0x80008000"
BR2_LINUX_KERNEL_INSTALL_TARGET=y
```

## configs/odriodu2_defconfig
```kconfig
BR2_arm=y
BR2_cortex_a9=y
BR2_ARM_EABIHF=y
BR2_ARM_ENABLE_NEON=y
BR2_ARM_FPU_VFPV3=y
BR2_OPTIMIZE_3=y
BR2_TOOLCHAIN_EXTERNAL=y
BR2_TOOLCHAIN_EXTERNAL_CUSTOM=y
BR2_TOOLCHAIN_EXTERNAL_PATH="/home/spenser/Code/odroid-toolchain/"
BR2_TOOLCHAIN_EXTERNAL_CUSTOM_PREFIX="$(ARCH)-linux-gnueabihf"
BR2_TOOLCHAIN_EXTERNAL_CUSTOM_GLIBC=y
BR2_TOOLCHAIN_EXTERNAL_CXX=y
BR2_TOOLCHAIN_EXTERNAL_GDB_SERVER_COPY=y
BR2_TARGET_GENERIC_GETTY_PORT="ttySAC1"
BR2_LINUX_KERNEL=y
BR2_LINUX_KERNEL_CUSTOM_GIT=y
BR2_LINUX_KERNEL_CUSTOM_GIT_REPO_URL="git://github.com/hardkernel/linux.git"
BR2_LINUX_KERNEL_CUSTOM_GIT_VERSION="38098b1e"
BR2_LINUX_KERNEL_DEFCONFIG="odroidu2_ubuntu_mali"
BR2_PACKAGE_KMOD=y
```

## package/beagle-capes/Config.in
```kconfig
config BR2_PACKAGE_BEAGLE_CAPES
	bool "beagle-capes"
	depends on BR2_LINUX_KERNEL && BR2_arm
	select BR2_LINUX_KERNEL_INSTALL_FIRMWARE
	help
	  Installs beaglebone capes firmwares.

	  These firmwares are bundled in the TI fork on the Linux kernel for the
	  BeagleBone; therefore, a kernel with these firmwares must be configured in
	  the Kernel Configuration section of Buildroot.

comment "beagle-capes requires a Linux kernel"
	depends on !(BR2_LINUX_KERNEL)
```

## package/binutils/Config.in.host
```kconfig
comment "Binutils Options"

choice
	prompt "Binutils Version"
	default BR2_BINUTILS_VERSION_ARC_GIT if BR2_arc
	default BR2_BINUTILS_VERSION_MB_GIT if BR2_microblaze
	default BR2_BINUTILS_VERSION_2_21 if (BR2_mips || BR2_mipsel || BR2_sh)
	default BR2_BINUTILS_VERSION_2_22
	help
	  Select the version of binutils you wish to use.

	config BR2_BINUTILS_VERSION_2_18_AVR32_1_0_1
		depends on BR2_avr32
		bool "binutils 2.18-avr32-1.0.1"

	config BR2_BINUTILS_VERSION_ARC_GIT
		depends on BR2_arc
		bool "binutils arc-git"

	config BR2_BINUTILS_VERSION_MB_GIT
		depends on BR2_microblaze
		bool "binutils mb-git"

	config BR2_BINUTILS_VERSION_2_20_1
		depends on !BR2_avr32
		depends on !BR2_ARM_EABIHF
		depends on !BR2_arc
		depends on !BR2_microblaze
		bool "binutils 2.20.1"

	config BR2_BINUTILS_VERSION_2_21
		depends on !BR2_avr32
		depends on !BR2_ARM_EABIHF
		depends on !BR2_arc
		depends on !BR2_microblaze
		bool "binutils 2.21"

	config BR2_BINUTILS_VERSION_2_21_1
		depends on !BR2_avr32
		depends on !BR2_ARM_EABIHF
		depends on !BR2_arc
		depends on !BR2_microblaze
		bool "binutils 2.21.1"

	config BR2_BINUTILS_VERSION_2_22
		depends on !BR2_avr32
		depends on !BR2_arc
		depends on !BR2_microblaze
		bool "binutils 2.22"

	config BR2_BINUTILS_VERSION_2_23_1
		depends on !BR2_avr32
		depends on !BR2_arc
		depends on !BR2_microblaze
		bool "binutils 2.23.1"

	config BR2_BINUTILS_VERSION_2_23_2
		depends on !BR2_avr32
		depends on !BR2_arc
		depends on !BR2_microblaze
		bool "binutils 2.23.2"

	config BR2_BINUTILS_VERSION_2_24
		depends on !BR2_avr32
		depends on !BR2_arc
		depends on !BR2_microblaze
		bool "binutils 2.24"

endchoice

config BR2_BINUTILS_VERSION
	string
	default "2.18-avr32-1.0.1" if BR2_BINUTILS_VERSION_2_18_AVR32_1_0_1
	default "arg-git" if BR2_BINUTILS_VERSION_ARC_GIT
	default "mb-git"  if BR2_BINUTILS_VERSION_MB_GIT
	default "2.20.1"	if BR2_BINUTILS_VERSION_2_20_1
	default "2.21"		if BR2_BINUTILS_VERSION_2_21
	default "2.21.1"	if BR2_BINUTILS_VERSION_2_21_1
	default "2.22"		if BR2_BINUTILS_VERSION_2_22
	default "2.23.1"	if BR2_BINUTILS_VERSION_2_23_1
	default "2.23.2"	if BR2_BINUTILS_VERSION_2_23_2
	default "2.24"		if BR2_BINUTILS_VERSION_2_24

config BR2_BINUTILS_EXTRA_CONFIG_OPTIONS
	string "Additional binutils options"
	default ""
	help
	  Any additional binutils options you may want to include.
```

## package/glmark2/Config.in
```kconfig
config BR2_PACKAGE_GLMARK2
	bool "glmark2"
	depends on BR2_PACKAGE_MESA3D
	depends on BR2_PACKAGE_MESA3D_GBM # depends on udev cannot select
	depends on BR2_LARGEFILE
	depends on BR2_PACKAGE_HAS_OPENGL || \
		(BR2_PACKAGE_HAS_OPENGL_EGL && BR2_PACKAGE_HAS_OPENGL_ES)
	select BR2_PACKAGE_JPEG
	select BR2_PACKAGE_LIBPNG12
	help
	  glmark2 is a benchmark for OpenGL (ES) 2.0. It uses only the subset of the
	  OpenGL 2.0 API that is compatible with OpenGL ES 2.0.

comment "glmark2 requires Mesa3D GBM support and largefile support in toolchain"
	depends on (BR2_PACKAGE_HAS_OPENGL || \
		(BR2_PACKAGE_HAS_OPENGL_EGL && BR2_PACKAGE_HAS_OPENGL_ES)) && \
		(!BR2_LARGEFILE || !BR2_PACKAGE_MESA3D_GBM)
```

## package/libpng12/Config.in
```kconfig
config BR2_PACKAGE_LIBPNG12
	bool "libpng12"
	select BR2_PACKAGE_ZLIB
	help
	  Library for handling PNG (Portable Network Graphics)
	  images. This installs the 1.2.x series.  Different versions of
	  libpng have different APIs.

	  http://www.libpng.org/
```

## package/mesa3d-demos/Config.in
```kconfig
config BR2_PACKAGE_MESA3D_DEMOS
	bool "mesa3d-demos"
	depends on BR2_PACKAGE_HAS_OPENGL || BR2_PACKAGE_HAS_OPENGL_ES \
		|| BR2_PACKAGE_HAS_OPENGL_EGL || BR2_PACKAGE_HAS_OPENVG
	help
	  OpenGL demos from the Mesa 3D project.

	  http://mesa3d.org
```

## package/mesa3d/Config.in
```kconfig
config BR2_PACKAGE_MESA3D
	bool "Mesa 3D Graphics Library"
	select BR2_PACKAGE_XPROTO_GLPROTO
	select BR2_PACKAGE_XLIB_LIBXXF86VM
	select BR2_PACKAGE_XLIB_LIBXDAMAGE
	select BR2_PACKAGE_XLIB_LIBXFIXES
	select BR2_PACKAGE_XPROTO_DRI2PROTO
	select BR2_PACKAGE_LIBDRM
	select BR2_PACKAGE_EXPAT
	select BR2_PACKAGE_HOST_LIBXML2_PYTHON
	select BR2_PACKAGE_XPROTO_DRI2_PROTO if BR2_PACKAGE_XSERVER_XORG_SERVER_MODULAR
	select BR2_PACKAGE_XPROTO_XF86DRIPROTO if BR2_PACKAGE_XSERVER_XORG_SERVER
	select BR2_PACKAGE_XLIB_LIBX11 if BR2_PACKAGE_XSERVER_XORG_SERVER
	select BR2_PACKAGE_XLIB_LIBXEXT if BR2_PACKAGE_XSERVER_XORG_SERVER
	select BR2_PACKAGE_XLIB_LIBXDAMAGE if BR2_PACKAGE_XSERVER_XORG_SERVER
	select BR2_PACKAGE_XLIB_LIBXFIXES if BR2_PACKAGE_XSERVER_XORG_SERVER
	select BR2_PACKAGE_LIBXCB if BR2_PACKAGE_XSERVER_XORG_SERVER
	depends on BR2_INSTALL_LIBSTDCPP
	depends on BR2_LARGEFILE
	help
	  Mesa 3D, an open-source implementation of the OpenGL specification.

	  http://mesa3d.org

if BR2_PACKAGE_MESA3D

menu "libraries"

config BR2_PACKAGE_MESA3D_GBM
	depends on BR2_PACKAGE_UDEV
	bool "gbm support"
	help
	  Add support for Graphics Buffer Manager.

config BR2_PACKAGE_MESA3D_XVMC
	bool "xvmc support"
	help
	  Add support for X Video Motion Compensation.

config BR2_PACKAGE_MESA3D_VDPAU
	bool "vdpau support"
	help
	  Add support for Video Decode and Presentation API for Unix.

endmenu

menu "Drivers"

config BR2_PACKAGE_MESA3D_GALLIUM_DRIVER_I915
	bool "Gallium i915 driver"
	depends on BR2_i386 || BR2_x86_64
	select BR2_PACKAGE_MESA3D_GALLIUM_DRIVER
	select BR2_PACKAGE_LIBDRM_INTEL
	help
	  Supports intel chips with Gallium. In most cases, the DRI i965 driver
	  should be used as it is better maintained by Intel.

config BR2_PACKAGE_MESA3D_GALLIUM_DRIVER_NOUVEAU
	bool "Gallium nouveau driver"
	depends on BR2_i386 || BR2_x86_64
	select BR2_PACKAGE_MESA3D_GALLIUM_DRIVER
	select BR2_PACKAGE_LIBDRM_NOUVEAU
	help
	  Supports all Nvidia GPUs.

config BR2_PACKAGE_MESA3D_GALLIUM_DRIVER_R300
	bool "Gallium r300 driver"
	depends on BR2_i386 || BR2_x86_64
	select BR2_PACKAGE_MESA3D_GALLIUM_DRIVER
	select BR2_PACKAGE_LIBDRM_RADEON
	help
	  Supports the R300, R400, and R500 series of ATI/AMD GPUs.

config BR2_PACKAGE_MESA3D_GALLIUM_DRIVER_R600
	bool "Gallium r600 driver"
	depends on BR2_i386 || BR2_x86_64
	select BR2_PACKAGE_MESA3D_GALLIUM_DRIVER
	select BR2_PACKAGE_LIBDRM_RADEON
	help
	  Supports the R600, R700, and R800 series of ATI/AMD GPUs.

config BR2_PACKAGE_MESA3D_GALLIUM_DRIVER_RADEONSI
	bool "Gallium radeonsi driver"
	depends on BR2_i386 || BR2_x86_64
	select BR2_PACKAGE_MESA3D_GALLIUM_DRIVER
	select BR2_PACKAGE_LIBDRM_RADEON
	help
	  Supports the Radeon HD7000/HD8000/HD9000 series of ATI/AMD GPUs.

config BR2_PACKAGE_MESA3D_GALLIUM_DRIVER_SVGA
	bool "Gallium vmware svga driver"
	select BR2_PACKAGE_MESA3D_GALLIUM_DRIVER
	select BR2_PACKAGE_LIBDRM_VMWGFX
	help
	  This is a virtual GPU driver for VMWare virtual machines.

config BR2_PACKAGE_MESA3D_GALLIUM_DRIVER_SWRAST
	bool "Gallium swrast driver"
	select BR2_PACKAGE_MESA3D_GALLIUM_DRIVER
	help
	  This is a software opengl implementation using the Gallium3D
	  infrastructure.

config BR2_PACKAGE_MESA3D_DRI_DRIVERS_SWRAST
	bool "DRI swrast driver"
	select BR2_PACKAGE_MESA3D_DRI_DRIVER
	help
	  This is a software opengl implementation using the DRI infrastructure.

config BR2_PACKAGE_MESA3D_DRI_DRIVERS_I965
	bool "DRI i965 driver"
	depends on BR2_i386 || BR2_x86_64
	select BR2_PACKAGE_MESA3D_DRI_DRIVER
	select BR2_PACKAGE_LIBDRM_INTEL
	help
	  Supports all Intel GPUs.  This version is most supported by Intel.

config BR2_PACKAGE_MESA3D_DRI_DRIVERS_RADEON
	bool "DRI radeon driver"
	depends on BR2_i386 || BR2_x86_64
	select BR2_PACKAGE_MESA3D_DRI_DRIVER
	select BR2_PACKAGE_LIBDRM_RADEON
	help
	  Legacy Radeon driver for R100 series GPUs.

endmenu

# The following hidden options inform gallium or dri driver selection.
config BR2_PACKAGE_MESA3D_GALLIUM_DRIVER
	select BR2_PACKAGE_MESA3D_DRIVER
	bool

config BR2_PACKAGE_MESA3D_DRI_DRIVER
	select BR2_PACKAGE_MESA3D_DRIVER
	bool

config BR2_PACKAGE_MESA3D_DRIVER
	bool

menu "API Support"
depends on BR2_PACKAGE_MESA3D_GALLIUM_DRIVER || BR2_PACKAGE_MESA3D_DRI_DRIVER

config BR2_PACKAGE_MESA3D_OPENGL
	bool "OpenGL"
	select BR2_PACKAGE_HAS_OPENGL
	help
	  Use the Khronos OpenGL API.  This is a desktop computer API and is not
	  normally implemented by embedded systems.

config BR2_PACKAGE_MESA3D_EGL
	bool "EGL"
	select BR2_PACKAGE_MESA3D_GBM
	select BR2_PACKAGE_HAS_OPENGL_EGL
	help
	  Use the Khronos EGL APIs. EGL is a window manager for OpenGL applications
	  similar to GLX, for X, and WGL, for Windows.

 config BR2_PACKAGE_MESA3D_OPENGL_ES
	bool "OpenGL ES"
	select BR2_PACKAGE_HAS_OPENGL_ES
	help
	  Use the Khronos OpenGL ES APIs.  This is commonly used on embedded
	  systems and represents a subset of the OpenGL API.

config BR2_PACKAGE_MESA3D_OPENVG
	bool "OpenVG"
	depends on BR2_PACKAGE_MESA3D_GALLIUM_DRIVER
	select BR2_PACKAGE_HAS_OPENVG
	select BR2_PACKAGE_MESA3D_OPENGL_EGL
	help
	  Use the Khronos OpenVG APIs. This is a 2D API commonly used on
	  embedded systems.

config BR2_PACKAGE_MESA3D_OPENCL
	bool "OpenCL"
	depends on BR2_PACKAGE_MESA3D_GALLIUM_DRIVER
	select BR2_PACKAGE_HAS_OPENCL
	help
	  Use the Khronos OpenCL APIs. This is a GPU computation language
	  commonly used in GPGPU computing applications.

endmenu

endif

comment "mesa3d depends on a toolchain with C++ and largefile support"
	depends on !BR2_LARGEFILE || !BR2_INSTALL_LIBSTDCPP
```

## package/qemu/Config.in.host
```kconfig
config BR2_PACKAGE_HOST_QEMU
	bool "host qemu"
	help
	  QEMU - Machine Emulator 

	  http://qemu.org/
```

## package/sunxi-cedarx/Config.in
```kconfig
config BR2_PACKAGE_SUNXI_CEDARX
	bool "sunxi-cedarx"
	depends on BR2_arm
	depends on BR2_TOOLCHAIN_USES_GLIBC
	help
	  Sunxi CedarX decoder libraries. CedarX is Allwinner's
	  multimedia co-processing technology for hardware accelerated
	  video and image decoding, as used inside their A10 SoC's and
	  others.

	  http://github.com/linux-sunxi/cedarx-libs
	  http://linux-sunxi.org/CedarX

if BR2_PACKAGE_SUNXI_CEDARX

config BR2_PACKAGE_SUNXI_CEDARX_DEMO
	bool "install enc_dec_test demo"
	help
	  Install a test program which verifies the functionality of the CedarX
	  libraries

endif

comment "sunxi-cedarx needs an (e)glibc toolchain"
	depends on BR2_arm
	depends on !BR2_TOOLCHAIN_USES_GLIBC
```
